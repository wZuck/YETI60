## firmware/target/boards/yeti/yeti60/board.yml
```yaml
board:
  name: yeti60
  full_name: YETI60 E73
  vendor: yeti
  socs:
    - name: nrf52840
```

## firmware/target/boards/yeti/yeti60/yeti60_defconfig
```kconfig
CONFIG_GPIO=y
CONFIG_ADC=y
CONFIG_BT=y
CONFIG_USB_DEVICE_STACK=y
CONFIG_CLOCK_CONTROL_NRF_K32SRC_RC=y
CONFIG_CLOCK_CONTROL_NRF_K32SRC_250PPM=y
CONFIG_NRF_APPROTECT_USE_UICR=y
CONFIG_USE_DT_CODE_PARTITION=y
CONFIG_FLASH=y
CONFIG_FLASH_MAP=y
CONFIG_FLASH_PAGE_LAYOUT=y
CONFIG_NVS=y
CONFIG_SETTINGS_NVS=y
CONFIG_MPU_ALLOW_FLASH_WRITE=y
CONFIG_GPIO_AS_PINRESET=y
CONFIG_NFCT_PINS_AS_GPIOS=y
```

## firmware/target/dts/bindings/kscan/yeti,ec60.yaml
```yaml
description: YETI60 EC scanner with schematic-generated pin contract
compatible: "yeti,ec60"
include: kscan.yaml
```

## variants/raytac/firmware/target/Kconfig
```kconfig
config YETI60_SCAN
    bool "YETI60 schematic-bound EC scanner"
    default y if BOARD_YETI60
    select ADC
    select GPIO
```

## variants/raytac/firmware/target/boards/yeti/yeti60/Kconfig.yeti60
```kconfig
config BOARD_YETI60
    select SOC_NRF52840_QIAA

config YETI60_ACTIVE_SCAN_MS
    int "YETI60 active scan interval (milliseconds)"
    default 4
    range 1 50
    depends on BOARD_YETI60
    help
      Delay between scan frames while a key is held or shortly after activity.

config YETI60_IDLE_SCAN_MS
    int "YETI60 idle scan interval (milliseconds)"
    default 30
    range 5 1000
    depends on BOARD_YETI60
    help
      Delay between scan frames after YETI60_IDLE_AFTER_MS without a key.
      This trades first-key latency for lower idle power.

config YETI60_IDLE_AFTER_MS
    int "YETI60 idle transition time (milliseconds)"
    default 30000
    range 100 60000
    depends on BOARD_YETI60
    help
      Time with no pressed or changed key before entering the idle scan rate.

config YETI60_AFE_IDLE_GATING
    bool "Power down the EC analog front-end between idle scans"
    default y
    depends on BOARD_YETI60
    help
      Use U8/AFE_EN to remove AFE_3V3 while idle. The AFE is kept on while a
      key is held, during calibration, and whenever activity is detected.
```

## variants/raytac/firmware/target/boards/yeti/yeti60/board.yml
```yaml
board:
  name: yeti60
  full_name: YETI60 MDBT50Q
  vendor: yeti
  socs:
    - name: nrf52840
```
